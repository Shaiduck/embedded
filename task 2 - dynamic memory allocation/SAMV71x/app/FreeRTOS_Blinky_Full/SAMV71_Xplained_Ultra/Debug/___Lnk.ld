/* ---------------------------------------------------------------------------- */
/*                  Atmel Microcontroller Software Support                      */
/*                       SAM Software Package License                           */
/* ---------------------------------------------------------------------------- */
/* Copyright (c) 2014, Atmel Corporation                                        */
/*                                                                              */
/* All rights reserved.                                                         */
/*                                                                              */
/* Redistribution and use in source and binary forms, with or without           */
/* modification, are permitted provided that the following condition is met:    */
/*                                                                              */
/* - Redistributions of source code must retain the above copyright notice,     */
/* this list of conditions and the disclaimer below.                            */
/*                                                                              */
/* Atmel's name may not be used to endorse or promote products derived from     */
/* this software without specific prior written permission.                     */
/*                                                                              */
/* DISCLAIMER:  THIS SOFTWARE IS PROVIDED BY ATMEL "AS IS" AND ANY EXPRESS OR   */
/* IMPLIED WARRANTIES, INCLUDING, BUT NOT LIMITED TO, THE IMPLIED WARRANTIES OF */
/* MERCHANTABILITY, FITNESS FOR A PARTICULAR PURPOSE AND NON-INFRINGEMENT ARE   */
/* DISCLAIMED. IN NO EVENT SHALL ATMEL BE LIABLE FOR ANY DIRECT, INDIRECT,      */
/* INCIDENTAL, SPECIAL, EXEMPLARY, OR CONSEQUENTIAL DAMAGES (INCLUDING, BUT NOT */
/* LIMITED TO, PROCUREMENT OF SUBSTITUTE GOODS OR SERVICES; LOSS OF USE, DATA,  */
/* OR PROFITS; OR BUSINESS INTERRUPTION) HOWEVER CAUSED AND ON ANY THEORY OF    */
/* LIABILITY, WHETHER IN CONTRACT, STRICT LIABILITY, OR TORT (INCLUDING         */
/* NEGLIGENCE OR OTHERWISE) ARISING IN ANY WAY OUT OF THE USE OF THIS SOFTWARE, */
/* EVEN IF ADVISED OF THE POSSIBILITY OF SUCH DAMAGE.                           */
/* ---------------------------------------------------------------------------- */

INPUT (E:\Examples_SVN\samples\Atmel\SAMV7x\SAMV71x\app\FreeRTOS_Blinky_Full\SAMV71_Xplained_Ultra\Debug\main_full.o 
E:\Examples_SVN\samples\Atmel\SAMV7x\SAMV71x\app\FreeRTOS_Blinky_Full\SAMV71_Xplained_Ultra\Debug\main.o 
E:\Examples_SVN\samples\Atmel\SAMV7x\SAMV71x\app\FreeRTOS_Blinky_Full\SAMV71_Xplained_Ultra\Debug\IntQueueTimer.o 
E:\Examples_SVN\samples\Atmel\SAMV7x\SAMV71x\app\FreeRTOS_Blinky_Full\SAMV71_Xplained_Ultra\Debug\system_sam.o 
E:\Examples_SVN\samples\Atmel\SAMV7x\SAMV71x\app\FreeRTOS_Blinky_Full\SAMV71_Xplained_Ultra\Debug\RegTest.o 
E:\Examples_SVN\samples\Atmel\SAMV7x\SAMV71x\app\FreeRTOS_Blinky_Full\SAMV71_Xplained_Ultra\Debug\syscalls.o 
E:\Examples_SVN\samples\Atmel\SAMV7x\SAMV71x\app\FreeRTOS_Blinky_Full\SAMV71_Xplained_Ultra\Debug\startup_sam.o 
E:\Examples_SVN\samples\Atmel\SAMV7x\SAMV71x\app\FreeRTOS_Blinky_Full\SAMV71_Xplained_Ultra\Debug\timers.o 
E:\Examples_SVN\samples\Atmel\SAMV7x\SAMV71x\app\FreeRTOS_Blinky_Full\SAMV71_Xplained_Ultra\Debug\event_groups.o 
E:\Examples_SVN\samples\Atmel\SAMV7x\SAMV71x\app\FreeRTOS_Blinky_Full\SAMV71_Xplained_Ultra\Debug\list.o 
E:\Examples_SVN\samples\Atmel\SAMV7x\SAMV71x\app\FreeRTOS_Blinky_Full\SAMV71_Xplained_Ultra\Debug\queue.o 
E:\Examples_SVN\samples\Atmel\SAMV7x\SAMV71x\app\FreeRTOS_Blinky_Full\SAMV71_Xplained_Ultra\Debug\tasks.o 
E:\Examples_SVN\samples\Atmel\SAMV7x\SAMV71x\app\FreeRTOS_Blinky_Full\SAMV71_Xplained_Ultra\Debug\heap_4.o 
E:\Examples_SVN\samples\Atmel\SAMV7x\SAMV71x\app\FreeRTOS_Blinky_Full\SAMV71_Xplained_Ultra\Debug\port.o 
E:\Examples_SVN\samples\Atmel\SAMV7x\SAMV71x\app\FreeRTOS_Blinky_Full\SAMV71_Xplained_Ultra\Debug\IntSemTest.o 
E:\Examples_SVN\samples\Atmel\SAMV7x\SAMV71x\app\FreeRTOS_Blinky_Full\SAMV71_Xplained_Ultra\Debug\QueueOverwrite.o 
E:\Examples_SVN\samples\Atmel\SAMV7x\SAMV71x\app\FreeRTOS_Blinky_Full\SAMV71_Xplained_Ultra\Debug\QueueSet.o 
E:\Examples_SVN\samples\Atmel\SAMV7x\SAMV71x\app\FreeRTOS_Blinky_Full\SAMV71_Xplained_Ultra\Debug\recmutex.o 
E:\Examples_SVN\samples\Atmel\SAMV7x\SAMV71x\app\FreeRTOS_Blinky_Full\SAMV71_Xplained_Ultra\Debug\semtest.o 
E:\Examples_SVN\samples\Atmel\SAMV7x\SAMV71x\app\FreeRTOS_Blinky_Full\SAMV71_Xplained_Ultra\Debug\TaskNotify.o 
E:\Examples_SVN\samples\Atmel\SAMV7x\SAMV71x\app\FreeRTOS_Blinky_Full\SAMV71_Xplained_Ultra\Debug\TimerDemo.o 
E:\Examples_SVN\samples\Atmel\SAMV7x\SAMV71x\app\FreeRTOS_Blinky_Full\SAMV71_Xplained_Ultra\Debug\BlockQ.o 
E:\Examples_SVN\samples\Atmel\SAMV7x\SAMV71x\app\FreeRTOS_Blinky_Full\SAMV71_Xplained_Ultra\Debug\blocktim.o 
E:\Examples_SVN\samples\Atmel\SAMV7x\SAMV71x\app\FreeRTOS_Blinky_Full\SAMV71_Xplained_Ultra\Debug\countsem.o 
E:\Examples_SVN\samples\Atmel\SAMV7x\SAMV71x\app\FreeRTOS_Blinky_Full\SAMV71_Xplained_Ultra\Debug\death.o 
E:\Examples_SVN\samples\Atmel\SAMV7x\SAMV71x\app\FreeRTOS_Blinky_Full\SAMV71_Xplained_Ultra\Debug\dynamic.o 
E:\Examples_SVN\samples\Atmel\SAMV7x\SAMV71x\app\FreeRTOS_Blinky_Full\SAMV71_Xplained_Ultra\Debug\EventGroupsDemo.o 
E:\Examples_SVN\samples\Atmel\SAMV7x\SAMV71x\app\FreeRTOS_Blinky_Full\SAMV71_Xplained_Ultra\Debug\GenQTest.o 
E:\Examples_SVN\samples\Atmel\SAMV7x\SAMV71x\app\FreeRTOS_Blinky_Full\SAMV71_Xplained_Ultra\Debug\IntQueue.o 
E:\Examples_SVN\samples\Atmel\SAMV7x\SAMV71x\app\FreeRTOS_Blinky_Full\SAMV71_Xplained_Ultra\Debug\flop.o 
E:\Examples_SVN\samples\Atmel\SAMV7x\SAMV71x\app\FreeRTOS_Blinky_Full\SAMV71_Xplained_Ultra\Debug\dbg_console.o 
E:\Examples_SVN\samples\Atmel\SAMV7x\SAMV71x\app\FreeRTOS_Blinky_Full\SAMV71_Xplained_Ultra\Debug\board_lowlevel.o 
E:\Examples_SVN\samples\Atmel\SAMV7x\SAMV71x\app\FreeRTOS_Blinky_Full\SAMV71_Xplained_Ultra\Debug\led.o 
E:\Examples_SVN\samples\Atmel\SAMV7x\SAMV71x\app\FreeRTOS_Blinky_Full\SAMV71_Xplained_Ultra\Debug\wdt.o 
E:\Examples_SVN\samples\Atmel\SAMV7x\SAMV71x\app\FreeRTOS_Blinky_Full\SAMV71_Xplained_Ultra\Debug\pmc.o 
E:\Examples_SVN\samples\Atmel\SAMV7x\SAMV71x\app\FreeRTOS_Blinky_Full\SAMV71_Xplained_Ultra\Debug\tc.o 
E:\Examples_SVN\samples\Atmel\SAMV7x\SAMV71x\app\FreeRTOS_Blinky_Full\SAMV71_Xplained_Ultra\Debug\uart.o 
E:\Examples_SVN\samples\Atmel\SAMV7x\SAMV71x\app\FreeRTOS_Blinky_Full\SAMV71_Xplained_Ultra\Debug\pio.o 
E:\Examples_SVN\samples\Atmel\SAMV7x\SAMV71x\app\FreeRTOS_Blinky_Full\SAMV71_Xplained_Ultra\Debug\mpu.o)

/*------------------------------------------------------------------------------
 *      Linker script for running in internal FLASH on the ATSAMV71Q21
 *----------------------------------------------------------------------------*/

OUTPUT_FORMAT("elf32-littlearm", "elf32-littlearm", "elf32-littlearm")
OUTPUT_ARCH(arm)
SEARCH_DIR(.)

/* Memory Spaces Definitions */
MEMORY
{
  rom (rx)  : ORIGIN = 0x00400000, LENGTH = 0x00200000
  ram (rwx) : ORIGIN = 0x20400000, LENGTH = 0x00060000
  sdram(rwx): ORIGIN = 0x70000000, LENGTH = 0x00200000
}

/* The stack size used by the application. NOTE: you need to adjust according to your application. */
STACK_SIZE = DEFINED(STACK_SIZE) ? STACK_SIZE : 0x2000;

/* The heapsize used by the application. NOTE: you need to adjust according to your application. */
HEAP_SIZE = DEFINED(HEAP_SIZE) ? HEAP_SIZE : 0x1000;

INCLUDE ..\..\..\toolset\gcc\sam_flash.ld
INCLUDE ..\..\..\toolset\gcc\sam_sdram.ld
